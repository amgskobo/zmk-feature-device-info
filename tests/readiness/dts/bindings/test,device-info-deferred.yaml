## tests/readiness/dts/bindings/test,device-info-deferred.yaml
```yaml
description: Synthetic deferred device for the Device Info codec fixture
compatible: "test,device-info-deferred"
include: base.yaml
```
